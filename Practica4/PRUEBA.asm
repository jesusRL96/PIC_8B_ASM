			PROCESSOR   16F887
	        __CONFIG    0X2007,0X2BE2
			__CONFIG	0X2008,0X3FFF
	        INCLUDE     <P16F887.INC>
			CBLOCK 		0X24
			DIS1,DIS2,DIS3,DIS4,DIS5,DIS6	
			ENDC
			CBLOCK		0X70
			W_R, ST_R,PC_R
			ENDC
			ORG			0X0000
     		GOTO		INICIO
			ORG			0X0004
			INCLUDE		<rescate.asm>
			GOTO		RSI
			INCLUDE		<TABLA7SEG.ASM>
			INCLUDE		<SUBS_TIEMPO.ASM>

;******************************************************************
;			CONFIGURACION DE PUERTOS
;PORTB.6--->PAUSA	PORTB.7--->CAMBIO
;******************************************************************

INICIO:		BSF		STATUS,RP0	;BANCO1
			MOVLW	0XF0
			MOVWF	TRISC
			CLRF	TRISA
			CLRF	TRISD
			MOVLW	0XF0
			MOVWF	TRISB
			MOVLW	0XFF		
			MOVWF	IOCB		;TODOS LOS PINES INT_ON_CHANGE	
			BCF		OPTION_REG,.7
			BCF		OPTION_REG,.5
			BCF		OPTION_REG,.4
			BCF		OPTION_REG,.3
			BSF		STATUS,RP1	;BANCO3
			CLRF	ANSEL
			CLRF	ANSELH	
			BCF		STATUS,RP1
			BCF		STATUS,RP0	;BANCO0
			MOVF	PORTB,W
			BCF		INTCON,RBIF	
			BCF		INTCON,T0IF	
			BSF		INTCON,RBIE
			BSF		INTCON,GIE	;PORTB ES FUENTE DE INT_ON_CHANGE		

;*****************************************************************
			CLRF	PORTC
			MOVLW	0XFF
			MOVWF	PORTA
			CLRF	DIS1
			CLRF	DIS2
			CLRF	DIS3                                                   
			CLRF	DIS4
			CLRF	DIS5
			CLRF	DIS6

			CALL	ASC_DES			
			BTFSS	0X30,.0
			GOTO	ASCENDENTE
			MOVLW	.9
			MOVWF	DIS1
			MOVWF	DIS2
			MOVWF	DIS3
			MOVWF	DIS4
			MOVWF	DIS5
			MOVWF	DIS6
			GOTO	DESCENDENTE

LIMP_6		CLRF	DIS6	
LIMP_5		CLRF	DIS5
LIMP_4		CLRF	DIS4
LIMP_3		CLRF	DIS3
LIMP_2		CLRF	DIS2
LIMP_1		CLRF	DIS1

ASCENDENTE	CLRF	0X31
			CALL	MOSTRAR
			NOP
			NOP
			NOP
			NOP
			CALL	BOTONES	;PREGUNTAR POR RB7 Y RB6
			BTFSC	0X31,.7
			GOTO	DESCENDENTE
			BTFSC	0X31,.6
			CALL	PAUSA

			INCF	DIS1,F		;INCREMENTOS
			MOVLW	.10
			XORWF	DIS1,W
			BTFSS	STATUS,Z
			GOTO	ASCENDENTE
			NOP	
			INCF	DIS2,F
			MOVLW	.10
			XORWF	DIS2,W
			BTFSS	STATUS,Z
			GOTO	LIMP_1
			NOP
			NOP
			INCF	DIS3,F	;26
			MOVLW	.10
			XORWF	DIS3,W
			BTFSS	STATUS,Z  
			GOTO	LIMP_2
					
			INCF	DIS4,F
			MOVLW	.10
			XORWF	DIS4,W
			BTFSS	STATUS,Z
			GOTO	LIMP_3
			NOP
			INCF	DIS5,F
			MOVLW	.10
			XORWF	DIS5,W
			BTFSS	STATUS,Z
			GOTO	LIMP_4
			NOP 
			NOP
			NOP						
			INCF	DIS6,F
			MOVLW	.10
			XORWF	DIS6,W
			BTFSS	STATUS,Z
			GOTO	LIMP_5
			GOTO	LIMP_6	;46

NUEVE_6		MOVLW	.9
			MOVWF	DIS6	
NUEVE_5		MOVLW	.9
			MOVWF	DIS5
NUEVE_4		MOVLW	.9
			MOVWF	DIS4
NUEVE_3		MOVLW	.9
			MOVWF	DIS3
NUEVE_2		MOVLW	.9
			MOVWF	DIS2
NUEVE_1		MOVLW	.9
			MOVWF	DIS1

DESCENDENTE	CLRF	0X31
			CALL	MOSTRAR

			CALL	BOTONES	;PREGUNTAR POR RB7 Y RB6
			BTFSC	0X31,.7
			GOTO	ASCENDENTE
			BTFSC	0X31,.6
			CALL	PAUSA
			
			DECF	DIS1,F		;DECREMENTOS
			MOVLW	.255
			XORWF	DIS1,W
			BTFSS	STATUS,Z
			GOTO	DESCENDENTE
			DECF	DIS2,F
			MOVLW	.255
			XORWF	DIS2,W
			BTFSS	STATUS,Z
			GOTO	NUEVE_1
			DECF	DIS3,F
			MOVLW	.255
			XORWF	DIS3,W
			BTFSS	STATUS,Z
			GOTO	NUEVE_2
			DECF	DIS4,F
			MOVLW	.255
			XORWF	DIS4,W
			BTFSS	STATUS,Z
			GOTO	NUEVE_3
			DECF	DIS5,F
			MOVLW	.255
			XORWF	DIS5,W
			BTFSS	STATUS,Z
			GOTO	NUEVE_4
			DECF	DIS6,F
			MOVLW	.255
			XORWF	DIS6,W
			BTFSS	STATUS,Z
			GOTO	NUEVE_5
			GOTO	NUEVE_6


PAUSA		CALL 	MOSTRAR
			BTFSS	PORTC,.6
			GOTO	PAUSA
			CALL	REBOTE
			BTFSC	PORTC,.6
			GOTO	$-1
			CALL	REBOTE
			CLRF	0X31
			RETURN
			
;+++++++++++++++++++++++++++++++++++++++++++++++++++++++++++++++++++++
MOSTRAR		MOVF	DIS1,W
			CALL	SIETESEGK
			MOVWF	PORTD
			BCF		PORTA,.0					
			CALL	_20E6
			BSF		PORTA,.0
			MOVF	DIS2,W
			CALL	SIETESEGK
			MOVWF	PORTD
			BCF		PORTA,.1
			CALL	_20E6
			BSF		PORTA,.1
			MOVF	DIS3,W
			CALL	SIETESEGK
			MOVWF	PORTD
			BCF		PORTA,.2				
			CALL	_20E6
			BSF		PORTA,.2
			MOVF	DIS4,W
			CALL	SIETESEGK
			MOVWF	PORTD
			BCF		PORTA,.3
			CALL	_20E6
			BSF		PORTA,.3
			MOVF	DIS5,W
			CALL	SIETESEGK
			MOVWF	PORTD
			BCF		PORTA,.4				
			CALL	_20E6
			BSF		PORTA,.4
			MOVF	DIS6,W
			CALL	SIETESEGK
			MOVWF	PORTD
			BCF		PORTA,.5
			CALL	_20E6
			BSF		PORTA,.5
			RETURN
			
ASC_DES		MOVLW	0X00		;ASCENDENTE
			BTFSC	PORTC,.7
			MOVLW	0X01		;DESCENDENTE
			MOVWF	0X30		;REGISTRO INDICADOR
			CALL	REBOTE
			BTFSC	PORTC,.7
			GOTO	$-1
			CALL	REBOTE
			RETURN

BOTONES		MOVF	PORTC,W
			ANDLW	0XC0
			BTFSC	STATUS,Z
			RETURN
			CALL	REBOTE
			BTFSC	PORTC,.6
			BSF		0X31,.6
			BTFSC	PORTC,.7
			BSF		0X31,.7
			MOVF	PORTC,W
			ANDLW	0XC0
			BTFSS	STATUS,Z
			GOTO	$-3
			CALL	REBOTE	
			RETURN	

REBOTE:		MOVLW		.142
			MOVWF		0X61
			MOVLW		.58
			MOVWF		0X62
			CALL		ST2V
			RETURN

_20E6		MOVLW	.102		;1648-1653		(1650)
			MOVWF	0X61
			MOVLW	.2
			MOVWF	0X62
			CALL	ST2V
			NOP
			NOP
			NOP
			NOP
			RETURN
;++++++++++++++++++++++++++++++++++++++++++++++++++++++++++++++++

RSI				CALL		REBOTE
				CLRF		0X40
				MOVF		PORTB,W

FUEF0			BTFSC		PORTB,4	;FILAS	
				GOTO		FUEF1
				MOVLW		.12
				GOTO		FINF			

FUEF1			BTFSC		PORTB,5	
				GOTO		FUEF2
				MOVLW		.8
				GOTO		FINF				

FUEF2			BTFSC		PORTB,6
				GOTO		FUEF3
				MOVLW		.4
				GOTO		FINF			

FUEF3			MOVLW		.0

FINF			MOVWF		0X40			
				CLRF		PORTB
				BSF			STATUS,RP0	;B1	
				MOVLW		0X0F
				MOVWF		TRISB
				MOVLW		0XFF
				MOVWF		WPUB
				BCF			STATUS,RP0	;B0
				CLRF		PORTB				
				BCF			OPTION_REG,.7

FUEC1			BTFSC		PORTB,1	;COLUMNAS
				GOTO		FUEC2
				MOVLW		.2
				GOTO		FINC			

FUEC2			BTFSC		PORTB,2	
				GOTO		FUEC3
				MOVLW		.1
				GOTO		FINC			

FUEC3			BTFSC		PORTB,3	
				GOTO		FUEC4
				MOVLW		.0
				GOTO		FINC			

FUEC4			MOVLW		.3


FINC			ADDWF		0X40,F
				MOVF		0X40,W
				XORLW		.0
				BTFSC		STATUS,Z
				GOTO		DO
				MOVF		0X40,W
				XORLW		.1
				BTFSC		STATUS,Z
				GOTO		DO#
				MOVF		0X40,W
				XORLW		.2
				BTFSC		STATUS,Z
				GOTO		RE
				MOVF		0X40,W
				XORLW		.3
				BTFSC		STATUS,Z
				GOTO		RE#
				MOVF		0X40,W
				XORLW		.4
				BTFSC		STATUS,Z
				GOTO		MI
				MOVF		0X40,W
				XORLW		.5
				BTFSC		STATUS,Z
				GOTO		FA
				MOVF		0X40,W	
				XORLW		.6
				BTFSC		STATUS,Z
				GOTO		FA#
				MOVF		0X40,W
				XORLW		.7
				BTFSC		STATUS,Z
				GOTO		SOL
				MOVF		0X40,W
				XORLW		.8
				BTFSC		STATUS,Z
				GOTO		SOL#
				MOVF		0X40,W
				XORLW		.9
				BTFSC		STATUS,Z
				GOTO		LA
				MOVF		0X40,W
				XORLW		.10
				BTFSC		STATUS,Z
				GOTO		LA#
				MOVF		0X40,W
				XORLW		.11
				BTFSC		STATUS,Z
				GOTO		SI
				MOVF		0X40,W
				XORLW		.12
				BTFSC		STATUS,Z
				GOTO		OCTAVA2
				MOVF		0X40,W
				XORLW		.13
				BTFSC		STATUS,Z
				GOTO		OCTAVA3
				MOVF		0X40,W
				XORLW		.14
				BTFSC		STATUS,Z
				GOTO		OCTAVA4
				GOTO		OCTAVA5

;************************INICIONOTAS***********************			
DO				CALL		OCTAVA?
				CALL		TABLADO
				MOVWF		0X42
				MOVF		0X44,W
				CALL		TABLADONOPS
				MOVWF		0X45	
				MOVF		0X44,W
				CALL		TABLADOPS				
				BSF			STATUS,RP0
				MOVWF		OPTION_REG
				BCF			STATUS,RP0
				MOVLW		0X39	;C
				MOVWF		0X23
				MOVLW		0x00	;NO SOSTENIDO
				MOVWF		0X32
				CALL		NOTA
				GOTO		FIN
;***********************************************************
DO#				CALL		OCTAVA?
				CALL		TABLADO#
				MOVWF		0X42
				MOVF		0X44,W
				CALL		TABLADO#NOPS
				MOVWF		0X45	
				MOVF		0X44,W
				CALL		TABLADOPS#
				BSF			STATUS,RP0
				MOVWF		OPTION_REG
				BCF			STATUS,RP0	
				MOVLW		0X39	;C
				MOVWF		0X23
				MOVLW		0X6D	;SOSTENIDO 
				MOVWF		0X32
				CALL		NOTA
				GOTO		FIN
;***********************************************************
RE				CALL		OCTAVA?
				CALL		TABLARE
				MOVWF		0X42
				MOVF		0X44,W
				CALL		TABLARENOPS
				MOVWF		0X45	
				MOVF		0X44,W
				CALL		TABLAREPS
				BSF			STATUS,RP0
				MOVWF		OPTION_REG
				BCF			STATUS,RP0
				MOVLW		0X5E	;D
				MOVWF		0X23
				MOVLW		0X00	;NO SOSTENIDO
				MOVWF		0X32
				CALL		NOTA
				GOTO		FIN
;***********************************************************
RE#				CALL		OCTAVA?
				CALL		TABLARE#
				MOVWF		0X42
				MOVF		0X44,W
				CALL		TABLARE#NOPS
				MOVWF		0X45	
				MOVF		0X44,W
				CALL		TABLAREPS#
				BSF			STATUS,RP0
				MOVWF		OPTION_REG
				BCF			STATUS,RP0	
				MOVLW		0X5E	;D
				MOVWF		0X23
				MOVLW		0X6D	;SOSTENIDO
				MOVWF		0X32
				CALL		NOTA
				GOTO		FIN
;***********************************************************
MI				CALL		OCTAVA?
				CALL		TABLAMI
				MOVWF		0X42
				MOVF		0X44,W
				CALL		TABLAMINOPS
				MOVWF		0X45	
				MOVF		0X44,W
				CALL		TABLAMIPS
				BSF			STATUS,RP0
				MOVWF		OPTION_REG
				BCF			STATUS,RP0				
				MOVLW		0X79	;E
				MOVWF		0X23
				MOVLW		0X00	;NO SOSTENIDO
				MOVWF		0X32
				CALL		NOTA
				GOTO		FIN
;***********************************************************
FA				CALL		OCTAVA?
				CALL		TABLAFA
				MOVWF		0X42
				MOVF		0X44,W
				CALL		TABLAFANOPS
				MOVWF		0X45	
				MOVF		0X44,W
				CALL		TABLAFAPS
				BSF			STATUS,RP0
				MOVWF		OPTION_REG
				BCF			STATUS,RP0
				MOVLW		0X71	;F
				MOVWF		0X23
				MOVLW		B'00000000'	;NO SOSTENIDO
				MOVWF		0X32
				CALL		NOTA
				GOTO		FIN
;***********************************************************
FA#				CALL		OCTAVA?
				CALL		TABLAFA#
				MOVWF		0X42
				MOVF		0X44,W
				CALL		TABLAFA#NOPS
				MOVWF		0X45	
				MOVF		0X44,W
				CALL		TABLAFAPS#
				BSF			STATUS,RP0
				MOVWF		OPTION_REG
				BCF			STATUS,RP0
				MOVLW		0X71	;F
				MOVWF		0X23
				MOVLW		0X6D	;SOSTENIDO
				MOVWF		0X32
				CALL		NOTA
				GOTO		FIN
;***********************************************************
SOL				CALL		OCTAVA?
				CALL		TABLASOL
				MOVWF		0X42
				MOVF		0X44,W
				CALL		TABLASOLNOPS
				MOVWF		0X45	
				MOVF		0X44,W
				CALL		TABLASOLPS
				BSF			STATUS,RP0
				MOVWF		OPTION_REG
				BCF			STATUS,RP0		
				MOVLW		0X7D	;G
				MOVWF		0X23
				MOVLW		0X00	;NO SOSTENIDO
				MOVWF		0X32
				CALL		NOTA
				GOTO		FIN
;***********************************************************
SOL#			CALL		OCTAVA?
				CALL		TABLASOL#
				MOVWF		0X42
				MOVF		0X44,W
				CALL		TABLASOL#NOPS
				MOVWF		0X45	
				MOVF		0X44,W
				CALL		TABLASOLPS#
				BSF			STATUS,RP0
				MOVWF		OPTION_REG
				BCF			STATUS,RP0	
				MOVLW		0X7D	;G
				MOVWF		0X23
				MOVLW		0X6D	; SOSTENIDO
				MOVWF		0X32
				CALL		NOTA
				GOTO		FIN
;***********************************************************
LA				CALL		OCTAVA?
				CALL		TABLALA
				MOVWF		0X42
				MOVF		0X44,W
				CALL		TABLALANOPS
				MOVWF		0X45	
				MOVF		0X44,W
				CALL		TABLALAPS
				BSF			STATUS,RP0
				MOVWF		OPTION_REG
				BCF			STATUS,RP0
				MOVLW		0X77	;A
				MOVWF		0X23
				MOVLW		0X00	;NO SOSTENIDO
				MOVWF		0X32
				CALL		NOTA
				GOTO		FIN
;***********************************************************
LA#				CALL		OCTAVA?
				CALL		TABLALA#
				MOVWF		0X42
				MOVF		0X44,W
				CALL		TABLALA#NOPS
				MOVWF		0X45	
				MOVF		0X44,W
				CALL		TABLALAPS#
				BSF			STATUS,RP0
				MOVWF		OPTION_REG
				BCF			STATUS,RP0
				MOVLW		0X77	;A
				MOVWF		0X23
				MOVLW		0X6D	; SOSTENIDO
				MOVWF		0X32
				CALL		NOTA
				GOTO		FIN
;***********************************************************
SI				CALL		OCTAVA?
				CALL		TABLASI
				MOVWF		0X42
				MOVF		0X44,W
				CALL		TABLASINOPS
				MOVWF		0X45	
				MOVF		0X44,W
				CALL		TABLASIPS
				BSF			STATUS,RP0
				MOVWF		OPTION_REG
				BCF			STATUS,RP0	
				MOVLW		0X7C	;B
				MOVWF		0X23
				MOVLW		0X00	;NO SOSTENIDO
				MOVWF		0X32
				CALL		NOTA
				GOTO		FIN
;*************************FINNOTAS**************************
OCTAVA2			MOVLW		.1
				MOVWF		0X41
				MOVF		PORTB,W
				XORLW		0X0F
				BTFSS		STATUS,Z
				GOTO		$-3
				CALL		REBOTE
				GOTO		FIN

OCTAVA3			MOVLW		.2
				MOVWF		0X41
				MOVF		PORTB,W
				XORLW		0X0F
				BTFSS		STATUS,Z
				GOTO		$-3
				CALL		REBOTE
				GOTO		FIN

OCTAVA4			MOVLW		.4
				MOVWF		0X41
				MOVF		PORTB,W
				XORLW		0X0F
				BTFSS		STATUS,Z
				GOTO		$-3
				CALL		REBOTE
				GOTO		FIN

OCTAVA5			MOVLW		.8
				MOVWF		0X41
				MOVF		PORTB,W
				XORLW		0X0F
				BTFSS		STATUS,Z
				GOTO		$-3
				CALL		REBOTE
				GOTO		FIN

FIN				BSF			STATUS,RP0	;B1
				MOVLW		0XF0
				MOVWF		TRISB
				BCF			STATUS,RP0	;B0
				BCF			OPTION_REG,.7
				MOVF		PORTB,W
				BCF			INTCON,RBIF
				
				INCLUDE		<resupera.asm>

;++++++++++++++++SUBRUTINAS++++++++++++++++++++++
OCTAVA?			BTFSS		0X41,0
				GOTO		$+3
				MOVLW		.0
				GOTO		CARGA
				BTFSS		0X41,1
				GOTO		$+3
				MOVLW		.1
				GOTO		CARGA
				BTFSS		0X41,2
				GOTO		$+3
				MOVLW		.2
				GOTO		CARGA
				BTFSS		0X41,3
				GOTO		$+3
				MOVLW		.3
				GOTO		CARGA

CARGA			MOVWF		0X44
				RETURN


NOTA 			MOVLW		0X32
				MOVWF		FSR
				MOVLW		B'00111101'
				MOVWF		PORTA


TONO			BCF			INTCON,T0IF				
				MOVF		0X42,W		;OCTAVA
				MOVWF		TMR0
				MOVF		INDF,W		;USURPADOR
				MOVWF		PORTD
				BTFSS		INTCON,T0IF
				GOTO		$-3
				MOVF		0X45,W
				MOVWF		0X46
				DECFSZ		0X46,F
				GOTO		$-1
				COMF		PORTC,F
				SWAPF		FSR,F
				COMF		PORTA,F
				MOVF		PORTA,W
				IORLW		B'00111100'
				MOVWF		PORTA
				MOVF		PORTB,W
				XORLW		0X0F
				BTFSS		STATUS,Z
				GOTO		TONO
				CALL		REBOTE
				RETURN
				END