				PROCESSOR   16F887
				INCLUDE <P16F887.inc>
                __CONFIG    0X2007,0X2BE2
				__CONFIG	0X2008,0X3FFF
			    ORG			0X00
			GOTO 		INICIO
			INCLUDE		<SUBS_TIEMPO.ASM>	
INICIO		CLRF		PORTA
			CLRF		PORTB
			BSF			STATUS,RP0
			CLRF		TRISA
			BSF			STATUS,RP1
			CLRF		ANSEL
			CLRF		ANSELH
			BCF			STATUS,RP1
			BCF			STATUS,RP0
			MOVLW		.20
			MOVWF		0X20
			MOVF		PORTB,W
			MOVWF		0X21
			MOVF		0X21,W
			SUBWF		0X20,W
			MOVWF		0X22
			CALL		SERVO
			GOTO		$-8


SERVO 		MOVLW		.10
			MOVWF		.27
CARGA		MOVF		0X21,W
			MOVWF		0X25
			MOVF		0X22,W
			MOVWF		0X26
			BSF			PORTA,.0
			CALL		_1MS
			DECFSZ		0X25,F
			GOTO		$-3
			BCF			PORTA,.0
			CALL		_1MS
			DECFSZ		0X26,F
			GOTO		$-3
			DECFSZ		0X27,F
			GOTO		CARGA
			RETURN

_1MS		MOVLW		.162
			MOVWF		0X60
			CALL		ST1V
			RETURN
					
END