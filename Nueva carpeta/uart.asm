				PROCESSOR   16F887
                __CONFIG    0X2007,0X2BE2
				__CONFIG	0X2008,0X3FFF
                INCLUDE     <P16F887.INC>
				CBLOCK		0X21
				UNID,DECE,CENTE
				ENDC
				CBLOCK		0X70
				W_R, ST_R, PC_R
				ENDC
				ORG			0X0000
				GOTO		INICIO
				ORG			0X0004
				INCLUDE     <rescate.asm>
				GOTO		RSI
				INCLUDE		<SUBS_TIEMPO.ASM>
INICIO			MOVLW		0X00
				MOVWF		PORTD
				BSF 		STATUS,RP0
				BSF			STATUS,RP1			;B3
				CLRF		ANSEL
				CLRF		ANSELH
				BCF			BAUDCTL,BRG16		;
				BCF			STATUS,RP1			;B1
				CLRF		TRISD
				BCF			TXSTA,TX9			;UART=8BITS
				BSF			TXSTA,BRGH
				BCF			TXSTA,SYNC			;UART=ASНNCRONO
				MOVLW		.12
				MOVWF		SPBRG				;UART=19200BAUDIOS
				BCF			STATUS,RP0			;B0
				BSF			RCSTA,SPEN			;UART=ON
				BSF			STATUS,RP0			;B1
				BSF			TXSTA,TXEN			;
				BCF			STATUS,RP0			;B0
				BCF			PIR1,RCIF
				BSF			STATUS,RP0			;B1
				BSF			PIE1,RCIE			;
				BSF			INTCON,PEIE
				BSF			INTCON,GIE			;UART-RX CON INTERRUPCIONES ACTIVADAS
				BCF			STATUS,RP0			;B0
				BCF			RCSTA,RX9			;
				BSF			RCSTA,CREN			;UART-RX=ON
		
OTRA_TX			BTFSS		PORTC,0
				GOTO		$-1
				CALL		T_25MS
				BTFSC		PORTC,0
				GOTO		$-1
				CALL		T_25MS
				MOVF		PORTB,W
				MOVWF		TXREG
				GOTO		OTRA_TX
		
RSI				MOVF		RCREG,W
				MOVWF		PORTD
				BCF			PIR1,RCIF
				INCLUDE		<resupera.asm>

	
T_25MS			MOVLW		.44
				MOVWF		0X61
				MOVLW		.94
				MOVWF		0X62
				CALL		ST2V
				RETURN
				END