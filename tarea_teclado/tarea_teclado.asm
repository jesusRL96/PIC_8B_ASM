	PROCESSOR   16F887
                __CONFIG    0X2007,0X2BE2
				__CONFIG	0X2008,0X3FFF
                INCLUDE     <P16F887.INC>
				CBLOCK		0X70
				W_R, ST_R,PC_R
				ENDC
				ORG			0X0000
				GOTO		INICIO
				ORG			0X0004
				INCLUDE		<rescate.asm>
				GOTO		RSI
				INCLUDE		<TABLA7SEG.ASM>
				INCLUDE		<SUBS_TIEMPO.ASM>
INICIO			MOVLW		0XFF
				MOVWF		PORTA
				CLRF		PORTD				
				;CORRESPONDE AL ARCHIVO INICIO
				BSF 		STATUS,RP0
				BSF			STATUS,RP1	;B3
				CLRF		ANSEL
				CLRF		ANSELH
				CLRF		STATUS		;B0
				;FIN ARCHIVO INICIO
				BSF			STATUS,RP0	;B1
				CLRF		TRISD
				CLRF		TRISA
				MOVLW		0XFF		
				MOVWF		IOCB		;TODOS LOS PINES INT_ON_CHANGE
				MOVLW		0XF0
				MOVWF		TRISB
				BCF			STATUS,RP0	;B0
				BCF			OPTION_REG,.7
				MOVF		PORTB,W
				BCF			INTCON,RBIF
				MOVWF		0X21
				BSF			INTCON,RBIE
				BSF			INTCON,GIE	;PORTB ES FUENTE DE INT_ON_CHANGE		

HOLA			MOVLW		B'11111111'	;"H"
				MOVWF		PORTD
				BCF			PORTA,.0
				CALL		TIEMPO
				BSF			PORTA,.0
				MOVLW		B'00000000'	;"0"
				MOVWF		PORTD
				BCF			PORTA,.1
				CALL		TIEMPO
				BSF			PORTA,.1
				MOVLW		B'11111111'	;"L"
				MOVWF		PORTD
				BCF			PORTA,.2
				CALL		TIEMPO
				BSF			PORTA,.2
				MOVLW		B'00000000'	;"A"
				MOVWF		PORTD
				BCF			PORTA,.3
				CALL		TIEMPO
				BSF			PORTA,.3
				GOTO		HOLA

RSI				CALL		T25MS
				MOVLW		0XFF
				MOVWF		PORTA
				CLRF		0X40
				MOVF		PORTB,W
				XORWF		0X21,F

FUEF0			BTFSS		0X21,0	;FILAS	
				GOTO		FUEF1
				MOVLW		.0
				GOTO		FINF			

FUEF1			BTFSS		0X21,1	
				GOTO		FUEF2
				MOVLW		.4
				GOTO		FINF				

FUEF2			BTFSS		0X21,2	
				GOTO		FUEF3
				MOVLW		.8
				GOTO		FINF			

FUEF3			MOVLW		.12
FINF			MOVWF		0X40			
				
				BSF			STATUS,RP0	;B1	
				MOVLW		0X0F
				MOVWF		TRISB
				BCF			STATUS,RP0	;B0
				CLRF		PORTB
				BCF			OPTION_REG,.7

				MOVF		PORTB,W
				XORWF		0X21,F

FUEC1			BTFSS		0X21,4	;COLUMNAS
				GOTO		FUEC2
				MOVLW		.0
				GOTO		FINC			

FUEC2			BTFSS		0X21,5	
				GOTO		FUEC3
				MOVLW		.1
				GOTO		FINC			

FUEC3			BTFSS		0X21,6	
				GOTO		FUEC4
				MOVLW		.2
				GOTO		FINC			

FUEC4			MOVLW		.3
FINC			ADDWF		0X40,F
				MOVF		0X40,W
				CALL 		TECLADO
				MOVWF		PORTD
				BCF			PORTA,0
				CALL 		T1SEG
				BSF			PORTA,0

				BSF			STATUS,RP0	;B1
				MOVLW		0XF0
				MOVWF		TRISB
				BCF			STATUS,RP0	;B0
				CLRF		PORTB
				BCF			OPTION_REG,.7
				MOVF		PORTB,W
				MOVWF		0X21
				BCF			INTCON,RBIF
				
				INCLUDE		<resupera.asm>

T25MS			MOVLW		.44
				MOVWF		0X61
				MOVLW		.94
				MOVWF		0X62
				CALL		ST2V
				RETURN

T1SEG			MOVLW		.9
				MOVWF		0X64
				MOVLW		.253
				MOVWF		0X65
				MOVLW		.73
				MOVWF		0X66
				CALL		ST3V
				NOP
				RETURN

TIEMPO			MOVLW		.44		;AUN NO CALCULADO
				MOVWF		0X61
				MOVLW		.94
				MOVWF		0X62
				CALL		ST2V
				RETURN
				END